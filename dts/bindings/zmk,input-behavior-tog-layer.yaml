## dts/bindings/zmk,input-behavior-tog-layer.yaml
```yaml
# Copyright (c) 2020 The ZMK Contributors
# SPDX-License-Identifier: MIT

description: Input Behavior To Toggole Layer

compatible: "zmk,input-behavior-tog-layer"

include: one_param.yaml

properties:
    require-prior-idle-ms:
        type: int
        required: false
        default: -1
        description: Time in milliseconds that must pass after the last keystroke before the layer can be toggled

    deactivation-positions:
        type: array
        required: false
        default: []
        description: Array of key positions that will trigger layer deactivation when pressed
```
